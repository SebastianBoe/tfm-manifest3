## west.yml
```yaml
manifest:
  remotes:
    - name: tfm
      url-base: https://git.trustedfirmware.org/TF-M
    - name: armmbed
      url-base: https://github.com/ARMmbed
    - name: mcutools
      url-base: https://github.com/mcu-tools
    - name: armsw
      url-base: https://github.com/ARM-software/
    - name: zephyr
      url-base: https://github.com/zephyrproject-rtos
  projects:
    - name: trusted-firmware-m
      remote: tfm
      revision: TF-Mv2.0.0-RC2
    - name: tf-m-extras
      remote: tfm
      revision: 805db7b
    - name: tf-m-tests
      remote: tfm
      # lib/ext/tf-m-tests/version.txt
      # Contains psa-arch-tests also?
      revision: b0875b6
    - name: mbedtls
      remote: armmbed
      revision: mbedtls-3.5.0
      # Post checkout commands
      # make generated_files
      # git apply ../trusted-firmware-m/lib/ext/mbedcrypto/*.patch
    - name: mcuboot
      remote: mcutools
      revision: v2.0.0
    - name: hal_nordic
      remote: zephyr
      revision: nrfx-3.0.0
    - name: qcbor
      url: https://github.com/laurencelundblade/QCBOR.git
      revision: v1.2

  self:
    path: tfm-manifest
```
